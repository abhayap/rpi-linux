## sound/soc/bcm/Kconfig
```kconfig
config SND_BCM2835_SOC_I2S
	tristate "SoC Audio support for the Broadcom BCM2835 I2S module"
	depends on ARCH_BCM2835 || COMPILE_TEST
	select SND_SOC_GENERIC_DMAENGINE_PCM
	select REGMAP_MMIO
	help
	  Say Y or M if you want to add support for codecs attached to
	  the BCM2835 I2S interface. You will also need
	  to select the audio interfaces to support below.

config SND_BCM2835_SOC_RPI_CODEC_WSP
	tristate "Support for Cirrus sound pi"
	depends on SND_BCM2835_SOC_I2S
	select SND_SOC_WM5102
	select SND_SOC_WM8804
	help
	  Say Y or M if you want to add support for Cirrus sound pi

config SND_BCM2835_SOC_IQAUDIO_DAC
	tristate "Support for IQaudIO-DAC"
	depends on SND_BCM2835_SOC_I2S
	select SND_SOC_PCM512x_I2C
	help
	  Say Y or M if you want to add support for IQaudIO-DAC.
```
